## sdkconfig.defaults
```kconfig
# Target
CONFIG_IDF_TARGET="esp32s3"

# USB Host
CONFIG_USB_OTG_SUPPORTED=y
CONFIG_USB_HOST_CONTROL_TRANSFER_MAX_SIZE=1024
CONFIG_USB_HOST_HW_BUFFER_BIAS_BALANCED=y
CONFIG_USB_HOST_HUBS_SUPPORTED=y

# 禁用 USB Serial JTAG 二级控制台，避免和 USB-OTG Host 抢引脚
CONFIG_ESP_CONSOLE_SECONDARY_NONE=y

# USB 调试日志
CONFIG_LOG_DEFAULT_LEVEL_DEBUG=y
CONFIG_LOG_DEFAULT_LEVEL=4
```
